/dts-v1/;

#include "sdm845-comma-common.dtsi"

/ {
	model = "comma.ai mici";
	compatible = "comma,mici", "qcom,sdm845";
	qcom,msm-id = <341 0x20001>, <321 0x20001>, <321 0x20000>, <348 0x20001>;
	qcom,board-id = <0x22 0>;
};

&tlmm {
	gpio-line-names = "", /* GPIO_0 */
			  "",
			  "",
			  "",
			  "",
			  "",
			  "",
			  "",
			  "",
			  "",
			  "", /* GPIO_10 */
			  "",
			  "",
			  "",
			  "",
			  "",
			  "",
			  "",
			  "",
			  "",
			  "", /* GPIO_20 */
			  "",
			  "",
			  "",
			  "",
			  "",
			  "",
			  "",
			  "",
			  "",
			  "", /* GPIO_30 */
			  "",
			  "",
			  "",
			  "",
			  "",
			  "",
			  "",
			  "",
			  "",
			  "", /* GPIO_40 */
			  "",
			  "",
			  "",
			  "",
			  "",
			  "",
			  "",
			  "",
			  "",
			  "LTE_RST_N", /* GPIO_50 */
			  "",
			  "LTE_BOOT",
			  "",
			  "",
			  "",
			  "",
			  "",
			  "",
			  "",
			  "", /* GPIO_60 */
			  "",
			  "",
			  "",
			  "",
			  "",
			  "",
			  "",
			  "",
			  "",
			  "", /* GPIO_70 */
			  "",
			  "",
			  "",
			  "",
			  "",
			  "",
			  "",
			  "",
			  "",
			  "", /* GPIO_80 */
			  "",
			  "",
			  "",
			  "",
			  "",
			  "",
			  "",
			  "",
			  "",
			  "", /* GPIO_90 */
			  "",
			  "",
			  "",
			  "",
			  "",
			  "",
			  "",
			  "",
			  "",
			  "", /* GPIO_100 */
			  "",
			  "",
			  "",
			  "",
			  "",
			  "",
			  "",
			  "",
			  "",
			  "", /* GPIO_110 */
			  "",
			  "",
			  "",
			  "",
			  "",
			  "LTE_PWRKEY",
			  "",
			  "",
			  "",
			  "", /* GPIO_120 */
			  "",
			  "",
			  "",
			  "",
			  "",
			  "",
			  "",
			  "",
			  "",
			  "", /* GPIO_130 */
			  "",
			  "",
			  "",
			  "",
			  "",
			  "",
			  "",
			  "",
			  "",
			  "", /* GPIO_140 */
			  "",
			  "",
			  "",
			  "",
			  "",
			  "",
			  "",
			  "",
			  "",
			  ""; /* GPIO_150 */
};
